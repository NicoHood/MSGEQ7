/*
  Copyright (c) 2015 NicoHood
  See the readme for credit to other people.

  MSGEQ7 Capture example
  Output via Serial

  Captures music via Serial into a PROGMEM array to use it later.
  Captured song example is "In The Morning Light (Radio Mix) - Robin Schulz"

  Reads MSGEQ7 IC with 7 different frequencys from range 0-255
  63Hz, 160Hz, 400Hz, 1kHz, 2.5kHz, 6.25KHz, 16kHz
*/

// MSGEQ7
#include "MSGEQ7.h"
#define pinAnalogLeft A0
#define pinAnalogRight A1
#define pinReset 6
#define pinStrobe 4
#define MSGEQ7_INTERVAL ReadsPerSecond(50)
#define MSGEQ7_SMOOTH false

CMSGEQ7<MSGEQ7_SMOOTH, pinReset, pinStrobe, pinAnalogLeft, pinAnalogRight> MSGEQ7;

void setup() {
  // Set the IC ready for reading
  MSGEQ7.begin();

  // Serial setup with faster baud rate gives more FPS (115200)
  Serial.begin(115200);

  while (true) {
    Serial.println(F("Waiting for a (single!) char to start."));
    Serial.println(F("Type 'P' for a playback of the capture."));
    Serial.println();

    // Wait for Serial to start capturing
    char c = 0;
    while ((c = Serial.read()) == -1);

    if (toupper(c) == 'P')
      printRecord();
    else
      break;
  }

  Serial.println(F("const uint8_t music[] PROGMEM = {"));
}

void loop() {
  static uint32_t count = 0;

  // Analyze without delay every interval
  bool newReading = MSGEQ7.read(MSGEQ7_INTERVAL);

  // Serial raw debug output
  if (newReading) {
    count++;

    // All channels together
    Serial.print(MSGEQ7.get(MSGEQ7_BASS));
    if (count % 10 != 0)
      Serial.print(F(", "));
    else
      Serial.println(F(","));
  }

  if (Serial.read() != -1) {
    Serial.println(0);
    Serial.println(F("};"));
    Serial.println();
    Serial.print(count);
    Serial.println(F(" bytes"));
    while (true);
  }
}

void printRecord() {
  // Print playback to the Serial
  for (uint32_t i = 0; i < getMusicSize(); i++)
  {
    // Visualize with characters as bars
    uint8_t input = getMusic(i);
    for (uint8_t i = 0; i < (input / 4); i++)
      Serial.print('=');
    Serial.println();

    // delaymicroseconds() is not precise on higher values
    delay(MSGEQ7_INTERVAL / 1000);
  }
  Serial.println(F("Playback finished"));
}


const uint8_t music[] PROGMEM = {
23, 20, 18, 16, 15, 15, 13, 14, 14, 15,
14, 14, 13, 14, 13, 14, 13, 15, 13, 14,
13, 15, 14, 14, 14, 14, 14, 14, 15, 14,
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15, 14, 14, 14, 14, 0
};


// Function wrappers to avoid putting the array
// at the top of the sketch.
uint8_t getMusic(uint32_t i) {
  return pgm_read_byte_near(music + i);
}

uint32_t getMusicSize() {
  return sizeof(music);
}

